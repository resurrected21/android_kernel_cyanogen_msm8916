## arch/arm/hotplug/Kconfig
```kconfig
config MSM_SLEEPER
 	bool "CPU hotplug driver"
 	default n
 	help
 	  CPU hotplug driver

config ALUCARD_HOTPLUG
	bool "Enable alucard-hotplug cpu hotplug driver"
 	default y
 	help
 	  Generic Alucard-hotplug cpu hotplug driver for ARM SOCs


config INTELLI_PLUG
	bool "Enable intelli-plug cpu hotplug driver"
	default n
	help
	  Generic Intelli-plug cpu hotplug driver for ARM SOCs
```
